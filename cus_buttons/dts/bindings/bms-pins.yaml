## cus_buttons/dts/bindings/bms-pins.yaml
```yaml
# Copyright (c) 2018, Linaro Limited
# SPDX-License-Identifier: Apache-2.0

description: GPIO KEYS parent node

compatible: "bms-pins"

child-binding:
    description: GPIO KEYS 2 child node
    properties:
       gpios:
          type: phandle-array
          required: true
       label:
          required: true
          type: string
          description: Human readable string describing the device (used as device_get_binding() argument)
```
